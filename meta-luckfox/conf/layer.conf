## meta-luckfox/conf/machine/include/luckfox-common.inc
```bitbake
PREFERRED_PROVIDER_virtual/kernel = "linux-rockchip"
OLDEST_KERNEL = "6.6"
MACHINE_ESSENTIAL_EXTRA_RRECOMMENDS += "kernel-modules"
KERNEL_IMAGETYPE = "zImage"

PREFERRED_PROVIDER_virtual/bootloader = "u-boot-rockchip"
```

## meta-luckfox/conf/machine/include/luckfox-rv1106.inc
```bitbake
require conf/machine/include/luckfox-common.inc

DEFAULTTUNE = "cortexa7thf-neon-vfpv4"
require conf/machine/include/arm/armv7a/tune-cortexa7.inc

MACHINEOVERRIDES =. "rv1106:"
UBOOT_MACHINE = "rv1106_defconfig"

SERIAL_CONSOLES = "115200;ttyFIQ0"
RK_SOC_FAMILY = "rv1106"
RK_ISP_VERSION = "3.2"
KBUILD_DEFCONFIG = "luckfox_rv1106_linux_defconfig"
```
